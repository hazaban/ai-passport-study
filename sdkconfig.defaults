## sdkconfig.defaults
```kconfig
# --- 目标芯片 ---
CONFIG_IDF_TARGET="esp32c3"
# 注:ESP32-C3 无 PSRAM,故不设 CONFIG_SPIRAM。

# --- Flash ---
# FoloToy AI Passport 当前产品/固件基线使用 8MB Flash。
CONFIG_ESPTOOLPY_FLASHSIZE_8MB=y
# 固定 8MB 镜像头，关闭 detect，便于 idf.py merge-bin。
CONFIG_ESPTOOLPY_HEADER_FLASHSIZE_UPDATE=n
# 3 MB 应用上限与小程序 BLE Recovery 安装器保持一致。分区表
# 还固定保留 cardid@0x356000 与 recovery@0x700000，二创不得改动。
CONFIG_PARTITION_TABLE_CUSTOM=y
CONFIG_PARTITION_TABLE_CUSTOM_FILENAME="partitions.csv"
CONFIG_PARTITION_TABLE_FILENAME="partitions.csv"

# 开机持续按住上键（GPIO0）5 秒，由自定义 bootloader 跳转到工厂
# 预装的 0x700000 Recovery。这些选项为 bootloader 提供长按检测配置。
CONFIG_BOOTLOADER_FACTORY_RESET=y
CONFIG_BOOTLOADER_NUM_PIN_FACTORY_RESET=0
CONFIG_BOOTLOADER_FACTORY_RESET_PIN_LOW=y
CONFIG_BOOTLOADER_OTA_DATA_ERASE=y
CONFIG_BOOTLOADER_DATA_FACTORY_RESET=""
CONFIG_BOOTLOADER_HOLD_TIME_GPIO=5

# --- 控制台:USB-Serial-JTAG(C3 原生 USB,GPIO18/19)---
# 不用 UART0:其默认 TX=GPIO21 与本板背光引脚冲突。
CONFIG_ESP_CONSOLE_USB_SERIAL_JTAG=y
CONFIG_ESP_CONSOLE_SECONDARY_NONE=y

# --- LVGL ---
CONFIG_LV_COLOR_DEPTH_16=y
CONFIG_LV_FONT_MONTSERRAT_10=y
CONFIG_LV_FONT_MONTSERRAT_12=y
CONFIG_LV_FONT_MONTSERRAT_14=y
CONFIG_LV_FONT_MONTSERRAT_20=y
# 支持字形数 > 255 的字体（中文字库必须开启）
CONFIG_LV_FONT_FMT_TXT_LARGE=y
# LVGL 内置 malloc 池大小(KB)。它是独立静态区、不与系统堆共享,配大了会白白占用 RAM。
# 考研助手含中文字体和多页面，需要更大内存。
CONFIG_LV_MEM_SIZE_KILOBYTES=40

# --- 系统 ---
CONFIG_FREERTOS_HZ=1000
# 考研助手不依赖任务看门狗（main 任务结束/长阻塞会误触发复位）；按需关闭，避免刷屏/复位。
CONFIG_ESP_TASK_WDT_EN=n

# --- LVGL 软渲染字体位图格式支持 ---
# study_font 为 bpp2(A2) 抗锯齿；缺 A1/A2/A4 支持时汉字会被画成一团黑块。
CONFIG_LV_DRAW_SW_SUPPORT_A1=y
CONFIG_LV_DRAW_SW_SUPPORT_A2=y
CONFIG_LV_DRAW_SW_SUPPORT_A4=y
CONFIG_LV_DRAW_SW_SUPPORT_A8=y
# study_font 由 lv_font_conv 以压缩(no-prefilter)格式生成；必须启用压缩解码，否则文字空白/乱码
CONFIG_LV_USE_FONT_COMPRESSED=y

# --- Bluetooth LE / NimBLE ---
# ESP32-C3 仅支持 BLE；示例只启用单连接 peripheral 所需的最小 host 配置。
CONFIG_BT_ENABLED=y
CONFIG_BT_NIMBLE_ENABLED=y
CONFIG_BT_NIMBLE_ROLE_CENTRAL=n
CONFIG_BT_NIMBLE_ROLE_PERIPHERAL=y
CONFIG_BT_NIMBLE_ROLE_BROADCASTER=y
CONFIG_BT_NIMBLE_ROLE_OBSERVER=n
CONFIG_BT_NIMBLE_MAX_CONNECTIONS=1
CONFIG_BT_NIMBLE_HOST_BASED_PRIVACY=n
CONFIG_BT_NIMBLE_NVS_PERSIST=n

# esp_timer 回调里跑 LVGL 首次渲染会超 3.5KB, 加大任务栈防止开机即栈溢出重启
CONFIG_ESP_TIMER_TASK_STACK_SIZE=8192
CONFIG_ESP_SYSTEM_USE_FRAME_POINTER=y

# 录音需更多堆：暂时关闭蓝牙(本应用不使用)
CONFIG_BT_ENABLED=n
CONFIG_BT_NIMBLE_ENABLED=n
```
